    IF :LNOT::DEF:INCLUDED_CYFITTERRV_INC
INCLUDED_CYFITTERRV_INC EQU 1
    GET cydevicerv.inc
    GET cydevicerv_trm.inc

; LCD_LCDPort
LCD_LCDPort__0__INTTYPE EQU CYREG_PICU0_INTTYPE0
LCD_LCDPort__0__MASK EQU 0x01
LCD_LCDPort__0__PC EQU CYREG_PRT0_PC0
LCD_LCDPort__0__PORT EQU 0
LCD_LCDPort__0__SHIFT EQU 0
LCD_LCDPort__1__INTTYPE EQU CYREG_PICU0_INTTYPE1
LCD_LCDPort__1__MASK EQU 0x02
LCD_LCDPort__1__PC EQU CYREG_PRT0_PC1
LCD_LCDPort__1__PORT EQU 0
LCD_LCDPort__1__SHIFT EQU 1
LCD_LCDPort__2__INTTYPE EQU CYREG_PICU0_INTTYPE2
LCD_LCDPort__2__MASK EQU 0x04
LCD_LCDPort__2__PC EQU CYREG_PRT0_PC2
LCD_LCDPort__2__PORT EQU 0
LCD_LCDPort__2__SHIFT EQU 2
LCD_LCDPort__3__INTTYPE EQU CYREG_PICU0_INTTYPE3
LCD_LCDPort__3__MASK EQU 0x08
LCD_LCDPort__3__PC EQU CYREG_PRT0_PC3
LCD_LCDPort__3__PORT EQU 0
LCD_LCDPort__3__SHIFT EQU 3
LCD_LCDPort__4__INTTYPE EQU CYREG_PICU0_INTTYPE4
LCD_LCDPort__4__MASK EQU 0x10
LCD_LCDPort__4__PC EQU CYREG_PRT0_PC4
LCD_LCDPort__4__PORT EQU 0
LCD_LCDPort__4__SHIFT EQU 4
LCD_LCDPort__5__INTTYPE EQU CYREG_PICU0_INTTYPE5
LCD_LCDPort__5__MASK EQU 0x20
LCD_LCDPort__5__PC EQU CYREG_PRT0_PC5
LCD_LCDPort__5__PORT EQU 0
LCD_LCDPort__5__SHIFT EQU 5
LCD_LCDPort__6__INTTYPE EQU CYREG_PICU0_INTTYPE6
LCD_LCDPort__6__MASK EQU 0x40
LCD_LCDPort__6__PC EQU CYREG_PRT0_PC6
LCD_LCDPort__6__PORT EQU 0
LCD_LCDPort__6__SHIFT EQU 6
LCD_LCDPort__AG EQU CYREG_PRT0_AG
LCD_LCDPort__AMUX EQU CYREG_PRT0_AMUX
LCD_LCDPort__BIE EQU CYREG_PRT0_BIE
LCD_LCDPort__BIT_MASK EQU CYREG_PRT0_BIT_MASK
LCD_LCDPort__BYP EQU CYREG_PRT0_BYP
LCD_LCDPort__CTL EQU CYREG_PRT0_CTL
LCD_LCDPort__DM0 EQU CYREG_PRT0_DM0
LCD_LCDPort__DM1 EQU CYREG_PRT0_DM1
LCD_LCDPort__DM2 EQU CYREG_PRT0_DM2
LCD_LCDPort__DR EQU CYREG_PRT0_DR
LCD_LCDPort__INP_DIS EQU CYREG_PRT0_INP_DIS
LCD_LCDPort__INTTYPE_BASE EQU CYDEV_PICU_INTTYPE_PICU0_BASE
LCD_LCDPort__LCD_COM_SEG EQU CYREG_PRT0_LCD_COM_SEG
LCD_LCDPort__LCD_EN EQU CYREG_PRT0_LCD_EN
LCD_LCDPort__MASK EQU 0x7F
LCD_LCDPort__PORT EQU 0
LCD_LCDPort__PRT EQU CYREG_PRT0_PRT
LCD_LCDPort__PRTDSI__CAPS_SEL EQU CYREG_PRT0_CAPS_SEL
LCD_LCDPort__PRTDSI__DBL_SYNC_IN EQU CYREG_PRT0_DBL_SYNC_IN
LCD_LCDPort__PRTDSI__OE_SEL0 EQU CYREG_PRT0_OE_SEL0
LCD_LCDPort__PRTDSI__OE_SEL1 EQU CYREG_PRT0_OE_SEL1
LCD_LCDPort__PRTDSI__OUT_SEL0 EQU CYREG_PRT0_OUT_SEL0
LCD_LCDPort__PRTDSI__OUT_SEL1 EQU CYREG_PRT0_OUT_SEL1
LCD_LCDPort__PRTDSI__SYNC_OUT EQU CYREG_PRT0_SYNC_OUT
LCD_LCDPort__PS EQU CYREG_PRT0_PS
LCD_LCDPort__SHIFT EQU 0
LCD_LCDPort__SLW EQU CYREG_PRT0_SLW

; LED
LED__0__INTTYPE EQU CYREG_PICU6_INTTYPE3
LED__0__MASK EQU 0x08
LED__0__PC EQU CYREG_PRT6_PC3
LED__0__PORT EQU 6
LED__0__SHIFT EQU 3
LED__AG EQU CYREG_PRT6_AG
LED__AMUX EQU CYREG_PRT6_AMUX
LED__BIE EQU CYREG_PRT6_BIE
LED__BIT_MASK EQU CYREG_PRT6_BIT_MASK
LED__BYP EQU CYREG_PRT6_BYP
LED__CTL EQU CYREG_PRT6_CTL
LED__DM0 EQU CYREG_PRT6_DM0
LED__DM1 EQU CYREG_PRT6_DM1
LED__DM2 EQU CYREG_PRT6_DM2
LED__DR EQU CYREG_PRT6_DR
LED__INP_DIS EQU CYREG_PRT6_INP_DIS
LED__INTTYPE_BASE EQU CYDEV_PICU_INTTYPE_PICU6_BASE
LED__LCD_COM_SEG EQU CYREG_PRT6_LCD_COM_SEG
LED__LCD_EN EQU CYREG_PRT6_LCD_EN
LED__MASK EQU 0x08
LED__PORT EQU 6
LED__PRT EQU CYREG_PRT6_PRT
LED__PRTDSI__CAPS_SEL EQU CYREG_PRT6_CAPS_SEL
LED__PRTDSI__DBL_SYNC_IN EQU CYREG_PRT6_DBL_SYNC_IN
LED__PRTDSI__OE_SEL0 EQU CYREG_PRT6_OE_SEL0
LED__PRTDSI__OE_SEL1 EQU CYREG_PRT6_OE_SEL1
LED__PRTDSI__OUT_SEL0 EQU CYREG_PRT6_OUT_SEL0
LED__PRTDSI__OUT_SEL1 EQU CYREG_PRT6_OUT_SEL1
LED__PRTDSI__SYNC_OUT EQU CYREG_PRT6_SYNC_OUT
LED__PS EQU CYREG_PRT6_PS
LED__SHIFT EQU 3
LED__SLW EQU CYREG_PRT6_SLW

; SPI_BSPIM
SPI_BSPIM_BitCounter__16BIT_CONTROL_AUX_CTL_REG EQU CYREG_B1_UDB09_10_ACTL
SPI_BSPIM_BitCounter__16BIT_CONTROL_CONTROL_REG EQU CYREG_B1_UDB09_10_CTL
SPI_BSPIM_BitCounter__16BIT_CONTROL_COUNT_REG EQU CYREG_B1_UDB09_10_CTL
SPI_BSPIM_BitCounter__16BIT_COUNT_CONTROL_REG EQU CYREG_B1_UDB09_10_CTL
SPI_BSPIM_BitCounter__16BIT_COUNT_COUNT_REG EQU CYREG_B1_UDB09_10_CTL
SPI_BSPIM_BitCounter__16BIT_MASK_MASK_REG EQU CYREG_B1_UDB09_10_MSK
SPI_BSPIM_BitCounter__16BIT_MASK_PERIOD_REG EQU CYREG_B1_UDB09_10_MSK
SPI_BSPIM_BitCounter__16BIT_PERIOD_MASK_REG EQU CYREG_B1_UDB09_10_MSK
SPI_BSPIM_BitCounter__16BIT_PERIOD_PERIOD_REG EQU CYREG_B1_UDB09_10_MSK
SPI_BSPIM_BitCounter__CONTROL_AUX_CTL_REG EQU CYREG_B1_UDB09_ACTL
SPI_BSPIM_BitCounter__CONTROL_REG EQU CYREG_B1_UDB09_CTL
SPI_BSPIM_BitCounter__CONTROL_ST_REG EQU CYREG_B1_UDB09_ST_CTL
SPI_BSPIM_BitCounter__COUNT_REG EQU CYREG_B1_UDB09_CTL
SPI_BSPIM_BitCounter__COUNT_ST_REG EQU CYREG_B1_UDB09_ST_CTL
SPI_BSPIM_BitCounter__MASK_CTL_AUX_CTL_REG EQU CYREG_B1_UDB09_MSK_ACTL
SPI_BSPIM_BitCounter__PER_CTL_AUX_CTL_REG EQU CYREG_B1_UDB09_MSK_ACTL
SPI_BSPIM_BitCounter__PERIOD_REG EQU CYREG_B1_UDB09_MSK
SPI_BSPIM_BitCounter_ST__16BIT_STATUS_AUX_CTL_REG EQU CYREG_B1_UDB09_10_ACTL
SPI_BSPIM_BitCounter_ST__16BIT_STATUS_REG EQU CYREG_B1_UDB09_10_ST
SPI_BSPIM_BitCounter_ST__MASK_REG EQU CYREG_B1_UDB09_MSK
SPI_BSPIM_BitCounter_ST__MASK_ST_AUX_CTL_REG EQU CYREG_B1_UDB09_MSK_ACTL
SPI_BSPIM_BitCounter_ST__PER_ST_AUX_CTL_REG EQU CYREG_B1_UDB09_MSK_ACTL
SPI_BSPIM_BitCounter_ST__STATUS_AUX_CTL_REG EQU CYREG_B1_UDB09_ACTL
SPI_BSPIM_BitCounter_ST__STATUS_CNT_REG EQU CYREG_B1_UDB09_ST_CTL
SPI_BSPIM_BitCounter_ST__STATUS_CONTROL_REG EQU CYREG_B1_UDB09_ST_CTL
SPI_BSPIM_BitCounter_ST__STATUS_REG EQU CYREG_B1_UDB09_ST
SPI_BSPIM_RxStsReg__16BIT_STATUS_AUX_CTL_REG EQU CYREG_B1_UDB10_11_ACTL
SPI_BSPIM_RxStsReg__16BIT_STATUS_REG EQU CYREG_B1_UDB10_11_ST
SPI_BSPIM_RxStsReg__4__MASK EQU 0x10
SPI_BSPIM_RxStsReg__4__POS EQU 4
SPI_BSPIM_RxStsReg__5__MASK EQU 0x20
SPI_BSPIM_RxStsReg__5__POS EQU 5
SPI_BSPIM_RxStsReg__6__MASK EQU 0x40
SPI_BSPIM_RxStsReg__6__POS EQU 6
SPI_BSPIM_RxStsReg__MASK EQU 0x70
SPI_BSPIM_RxStsReg__MASK_REG EQU CYREG_B1_UDB10_MSK
SPI_BSPIM_RxStsReg__STATUS_AUX_CTL_REG EQU CYREG_B1_UDB10_ACTL
SPI_BSPIM_RxStsReg__STATUS_REG EQU CYREG_B1_UDB10_ST
SPI_BSPIM_sR8_Dp_u0__16BIT_A0_REG EQU CYREG_B1_UDB09_10_A0
SPI_BSPIM_sR8_Dp_u0__16BIT_A1_REG EQU CYREG_B1_UDB09_10_A1
SPI_BSPIM_sR8_Dp_u0__16BIT_D0_REG EQU CYREG_B1_UDB09_10_D0
SPI_BSPIM_sR8_Dp_u0__16BIT_D1_REG EQU CYREG_B1_UDB09_10_D1
SPI_BSPIM_sR8_Dp_u0__16BIT_DP_AUX_CTL_REG EQU CYREG_B1_UDB09_10_ACTL
SPI_BSPIM_sR8_Dp_u0__16BIT_F0_REG EQU CYREG_B1_UDB09_10_F0
SPI_BSPIM_sR8_Dp_u0__16BIT_F1_REG EQU CYREG_B1_UDB09_10_F1
SPI_BSPIM_sR8_Dp_u0__A0_A1_REG EQU CYREG_B1_UDB09_A0_A1
SPI_BSPIM_sR8_Dp_u0__A0_REG EQU CYREG_B1_UDB09_A0
SPI_BSPIM_sR8_Dp_u0__A1_REG EQU CYREG_B1_UDB09_A1
SPI_BSPIM_sR8_Dp_u0__D0_D1_REG EQU CYREG_B1_UDB09_D0_D1
SPI_BSPIM_sR8_Dp_u0__D0_REG EQU CYREG_B1_UDB09_D0
SPI_BSPIM_sR8_Dp_u0__D1_REG EQU CYREG_B1_UDB09_D1
SPI_BSPIM_sR8_Dp_u0__DP_AUX_CTL_REG EQU CYREG_B1_UDB09_ACTL
SPI_BSPIM_sR8_Dp_u0__F0_F1_REG EQU CYREG_B1_UDB09_F0_F1
SPI_BSPIM_sR8_Dp_u0__F0_REG EQU CYREG_B1_UDB09_F0
SPI_BSPIM_sR8_Dp_u0__F1_REG EQU CYREG_B1_UDB09_F1
SPI_BSPIM_sR8_Dp_u0__MSK_DP_AUX_CTL_REG EQU CYREG_B1_UDB09_MSK_ACTL
SPI_BSPIM_sR8_Dp_u0__PER_DP_AUX_CTL_REG EQU CYREG_B1_UDB09_MSK_ACTL
SPI_BSPIM_TxStsReg__0__MASK EQU 0x01
SPI_BSPIM_TxStsReg__0__POS EQU 0
SPI_BSPIM_TxStsReg__1__MASK EQU 0x02
SPI_BSPIM_TxStsReg__1__POS EQU 1
SPI_BSPIM_TxStsReg__16BIT_STATUS_AUX_CTL_REG EQU CYREG_B1_UDB08_09_ACTL
SPI_BSPIM_TxStsReg__16BIT_STATUS_REG EQU CYREG_B1_UDB08_09_ST
SPI_BSPIM_TxStsReg__2__MASK EQU 0x04
SPI_BSPIM_TxStsReg__2__POS EQU 2
SPI_BSPIM_TxStsReg__3__MASK EQU 0x08
SPI_BSPIM_TxStsReg__3__POS EQU 3
SPI_BSPIM_TxStsReg__4__MASK EQU 0x10
SPI_BSPIM_TxStsReg__4__POS EQU 4
SPI_BSPIM_TxStsReg__MASK EQU 0x1F
SPI_BSPIM_TxStsReg__MASK_REG EQU CYREG_B1_UDB08_MSK
SPI_BSPIM_TxStsReg__STATUS_AUX_CTL_REG EQU CYREG_B1_UDB08_ACTL
SPI_BSPIM_TxStsReg__STATUS_REG EQU CYREG_B1_UDB08_ST

; SPI_CLK
SPI_CLK__0__INTTYPE EQU CYREG_PICU5_INTTYPE0
SPI_CLK__0__MASK EQU 0x01
SPI_CLK__0__PC EQU CYREG_PRT5_PC0
SPI_CLK__0__PORT EQU 5
SPI_CLK__0__SHIFT EQU 0
SPI_CLK__AG EQU CYREG_PRT5_AG
SPI_CLK__AMUX EQU CYREG_PRT5_AMUX
SPI_CLK__BIE EQU CYREG_PRT5_BIE
SPI_CLK__BIT_MASK EQU CYREG_PRT5_BIT_MASK
SPI_CLK__BYP EQU CYREG_PRT5_BYP
SPI_CLK__CTL EQU CYREG_PRT5_CTL
SPI_CLK__DM0 EQU CYREG_PRT5_DM0
SPI_CLK__DM1 EQU CYREG_PRT5_DM1
SPI_CLK__DM2 EQU CYREG_PRT5_DM2
SPI_CLK__DR EQU CYREG_PRT5_DR
SPI_CLK__INP_DIS EQU CYREG_PRT5_INP_DIS
SPI_CLK__INTTYPE_BASE EQU CYDEV_PICU_INTTYPE_PICU5_BASE
SPI_CLK__LCD_COM_SEG EQU CYREG_PRT5_LCD_COM_SEG
SPI_CLK__LCD_EN EQU CYREG_PRT5_LCD_EN
SPI_CLK__MASK EQU 0x01
SPI_CLK__PORT EQU 5
SPI_CLK__PRT EQU CYREG_PRT5_PRT
SPI_CLK__PRTDSI__CAPS_SEL EQU CYREG_PRT5_CAPS_SEL
SPI_CLK__PRTDSI__DBL_SYNC_IN EQU CYREG_PRT5_DBL_SYNC_IN
SPI_CLK__PRTDSI__OE_SEL0 EQU CYREG_PRT5_OE_SEL0
SPI_CLK__PRTDSI__OE_SEL1 EQU CYREG_PRT5_OE_SEL1
SPI_CLK__PRTDSI__OUT_SEL0 EQU CYREG_PRT5_OUT_SEL0
SPI_CLK__PRTDSI__OUT_SEL1 EQU CYREG_PRT5_OUT_SEL1
SPI_CLK__PRTDSI__SYNC_OUT EQU CYREG_PRT5_SYNC_OUT
SPI_CLK__PS EQU CYREG_PRT5_PS
SPI_CLK__SHIFT EQU 0
SPI_CLK__SLW EQU CYREG_PRT5_SLW

; SPI_Clock
SPI_Clock__CFG0 EQU CYREG_CLKDIST_DCFG0_CFG0
SPI_Clock__CFG1 EQU CYREG_CLKDIST_DCFG0_CFG1
SPI_Clock__CFG2 EQU CYREG_CLKDIST_DCFG0_CFG2
SPI_Clock__CFG2_SRC_SEL_MASK EQU 0x07
SPI_Clock__INDEX EQU 0x00
SPI_Clock__PM_ACT_CFG EQU CYREG_PM_ACT_CFG2
SPI_Clock__PM_ACT_MSK EQU 0x01
SPI_Clock__PM_STBY_CFG EQU CYREG_PM_STBY_CFG2
SPI_Clock__PM_STBY_MSK EQU 0x01

; SPI_CS
SPI_CS__0__INTTYPE EQU CYREG_PICU5_INTTYPE2
SPI_CS__0__MASK EQU 0x04
SPI_CS__0__PC EQU CYREG_PRT5_PC2
SPI_CS__0__PORT EQU 5
SPI_CS__0__SHIFT EQU 2
SPI_CS__AG EQU CYREG_PRT5_AG
SPI_CS__AMUX EQU CYREG_PRT5_AMUX
SPI_CS__BIE EQU CYREG_PRT5_BIE
SPI_CS__BIT_MASK EQU CYREG_PRT5_BIT_MASK
SPI_CS__BYP EQU CYREG_PRT5_BYP
SPI_CS__CTL EQU CYREG_PRT5_CTL
SPI_CS__DM0 EQU CYREG_PRT5_DM0
SPI_CS__DM1 EQU CYREG_PRT5_DM1
SPI_CS__DM2 EQU CYREG_PRT5_DM2
SPI_CS__DR EQU CYREG_PRT5_DR
SPI_CS__INP_DIS EQU CYREG_PRT5_INP_DIS
SPI_CS__INTTYPE_BASE EQU CYDEV_PICU_INTTYPE_PICU5_BASE
SPI_CS__LCD_COM_SEG EQU CYREG_PRT5_LCD_COM_SEG
SPI_CS__LCD_EN EQU CYREG_PRT5_LCD_EN
SPI_CS__MASK EQU 0x04
SPI_CS__PORT EQU 5
SPI_CS__PRT EQU CYREG_PRT5_PRT
SPI_CS__PRTDSI__CAPS_SEL EQU CYREG_PRT5_CAPS_SEL
SPI_CS__PRTDSI__DBL_SYNC_IN EQU CYREG_PRT5_DBL_SYNC_IN
SPI_CS__PRTDSI__OE_SEL0 EQU CYREG_PRT5_OE_SEL0
SPI_CS__PRTDSI__OE_SEL1 EQU CYREG_PRT5_OE_SEL1
SPI_CS__PRTDSI__OUT_SEL0 EQU CYREG_PRT5_OUT_SEL0
SPI_CS__PRTDSI__OUT_SEL1 EQU CYREG_PRT5_OUT_SEL1
SPI_CS__PRTDSI__SYNC_OUT EQU CYREG_PRT5_SYNC_OUT
SPI_CS__PS EQU CYREG_PRT5_PS
SPI_CS__SHIFT EQU 2
SPI_CS__SLW EQU CYREG_PRT5_SLW

; SPI_MISO
SPI_MISO__0__INTTYPE EQU CYREG_PICU5_INTTYPE4
SPI_MISO__0__MASK EQU 0x10
SPI_MISO__0__PC EQU CYREG_PRT5_PC4
SPI_MISO__0__PORT EQU 5
SPI_MISO__0__SHIFT EQU 4
SPI_MISO__AG EQU CYREG_PRT5_AG
SPI_MISO__AMUX EQU CYREG_PRT5_AMUX
SPI_MISO__BIE EQU CYREG_PRT5_BIE
SPI_MISO__BIT_MASK EQU CYREG_PRT5_BIT_MASK
SPI_MISO__BYP EQU CYREG_PRT5_BYP
SPI_MISO__CTL EQU CYREG_PRT5_CTL
SPI_MISO__DM0 EQU CYREG_PRT5_DM0
SPI_MISO__DM1 EQU CYREG_PRT5_DM1
SPI_MISO__DM2 EQU CYREG_PRT5_DM2
SPI_MISO__DR EQU CYREG_PRT5_DR
SPI_MISO__INP_DIS EQU CYREG_PRT5_INP_DIS
SPI_MISO__INTTYPE_BASE EQU CYDEV_PICU_INTTYPE_PICU5_BASE
SPI_MISO__LCD_COM_SEG EQU CYREG_PRT5_LCD_COM_SEG
SPI_MISO__LCD_EN EQU CYREG_PRT5_LCD_EN
SPI_MISO__MASK EQU 0x10
SPI_MISO__PORT EQU 5
SPI_MISO__PRT EQU CYREG_PRT5_PRT
SPI_MISO__PRTDSI__CAPS_SEL EQU CYREG_PRT5_CAPS_SEL
SPI_MISO__PRTDSI__DBL_SYNC_IN EQU CYREG_PRT5_DBL_SYNC_IN
SPI_MISO__PRTDSI__OE_SEL0 EQU CYREG_PRT5_OE_SEL0
SPI_MISO__PRTDSI__OE_SEL1 EQU CYREG_PRT5_OE_SEL1
SPI_MISO__PRTDSI__OUT_SEL0 EQU CYREG_PRT5_OUT_SEL0
SPI_MISO__PRTDSI__OUT_SEL1 EQU CYREG_PRT5_OUT_SEL1
SPI_MISO__PRTDSI__SYNC_OUT EQU CYREG_PRT5_SYNC_OUT
SPI_MISO__PS EQU CYREG_PRT5_PS
SPI_MISO__SHIFT EQU 4
SPI_MISO__SLW EQU CYREG_PRT5_SLW

; SPI_MOSI
SPI_MOSI__0__INTTYPE EQU CYREG_PICU5_INTTYPE6
SPI_MOSI__0__MASK EQU 0x40
SPI_MOSI__0__PC EQU CYREG_PRT5_PC6
SPI_MOSI__0__PORT EQU 5
SPI_MOSI__0__SHIFT EQU 6
SPI_MOSI__AG EQU CYREG_PRT5_AG
SPI_MOSI__AMUX EQU CYREG_PRT5_AMUX
SPI_MOSI__BIE EQU CYREG_PRT5_BIE
SPI_MOSI__BIT_MASK EQU CYREG_PRT5_BIT_MASK
SPI_MOSI__BYP EQU CYREG_PRT5_BYP
SPI_MOSI__CTL EQU CYREG_PRT5_CTL
SPI_MOSI__DM0 EQU CYREG_PRT5_DM0
SPI_MOSI__DM1 EQU CYREG_PRT5_DM1
SPI_MOSI__DM2 EQU CYREG_PRT5_DM2
SPI_MOSI__DR EQU CYREG_PRT5_DR
SPI_MOSI__INP_DIS EQU CYREG_PRT5_INP_DIS
SPI_MOSI__INTTYPE_BASE EQU CYDEV_PICU_INTTYPE_PICU5_BASE
SPI_MOSI__LCD_COM_SEG EQU CYREG_PRT5_LCD_COM_SEG
SPI_MOSI__LCD_EN EQU CYREG_PRT5_LCD_EN
SPI_MOSI__MASK EQU 0x40
SPI_MOSI__PORT EQU 5
SPI_MOSI__PRT EQU CYREG_PRT5_PRT
SPI_MOSI__PRTDSI__CAPS_SEL EQU CYREG_PRT5_CAPS_SEL
SPI_MOSI__PRTDSI__DBL_SYNC_IN EQU CYREG_PRT5_DBL_SYNC_IN
SPI_MOSI__PRTDSI__OE_SEL0 EQU CYREG_PRT5_OE_SEL0
SPI_MOSI__PRTDSI__OE_SEL1 EQU CYREG_PRT5_OE_SEL1
SPI_MOSI__PRTDSI__OUT_SEL0 EQU CYREG_PRT5_OUT_SEL0
SPI_MOSI__PRTDSI__OUT_SEL1 EQU CYREG_PRT5_OUT_SEL1
SPI_MOSI__PRTDSI__SYNC_OUT EQU CYREG_PRT5_SYNC_OUT
SPI_MOSI__PS EQU CYREG_PRT5_PS
SPI_MOSI__SHIFT EQU 6
SPI_MOSI__SLW EQU CYREG_PRT5_SLW

; Miscellaneous
BCLK__BUS_CLK__HZ EQU 24000000
BCLK__BUS_CLK__KHZ EQU 24000
BCLK__BUS_CLK__MHZ EQU 24
CYDEV_CHIP_DIE_LEOPARD EQU 1
CYDEV_CHIP_DIE_PANTHER EQU 18
CYDEV_CHIP_DIE_PSOC4A EQU 10
CYDEV_CHIP_DIE_PSOC5LP EQU 17
CYDEV_CHIP_DIE_TMA4 EQU 2
CYDEV_CHIP_DIE_UNKNOWN EQU 0
CYDEV_CHIP_FAMILY_PSOC3 EQU 1
CYDEV_CHIP_FAMILY_PSOC4 EQU 2
CYDEV_CHIP_FAMILY_PSOC5 EQU 3
CYDEV_CHIP_FAMILY_UNKNOWN EQU 0
CYDEV_CHIP_FAMILY_USED EQU CYDEV_CHIP_FAMILY_PSOC5
CYDEV_CHIP_JTAG_ID EQU 0x2E123069
CYDEV_CHIP_MEMBER_3A EQU 1
CYDEV_CHIP_MEMBER_4A EQU 10
CYDEV_CHIP_MEMBER_4C EQU 15
CYDEV_CHIP_MEMBER_4D EQU 6
CYDEV_CHIP_MEMBER_4E EQU 4
CYDEV_CHIP_MEMBER_4F EQU 11
CYDEV_CHIP_MEMBER_4G EQU 2
CYDEV_CHIP_MEMBER_4H EQU 9
CYDEV_CHIP_MEMBER_4I EQU 14
CYDEV_CHIP_MEMBER_4J EQU 7
CYDEV_CHIP_MEMBER_4K EQU 8
CYDEV_CHIP_MEMBER_4L EQU 13
CYDEV_CHIP_MEMBER_4M EQU 12
CYDEV_CHIP_MEMBER_4N EQU 5
CYDEV_CHIP_MEMBER_4U EQU 3
CYDEV_CHIP_MEMBER_5A EQU 17
CYDEV_CHIP_MEMBER_5B EQU 16
CYDEV_CHIP_MEMBER_UNKNOWN EQU 0
CYDEV_CHIP_MEMBER_USED EQU CYDEV_CHIP_MEMBER_5B
CYDEV_CHIP_DIE_EXPECT EQU CYDEV_CHIP_MEMBER_USED
CYDEV_CHIP_DIE_ACTUAL EQU CYDEV_CHIP_DIE_EXPECT
CYDEV_CHIP_REV_LEOPARD_ES1 EQU 0
CYDEV_CHIP_REV_LEOPARD_ES2 EQU 1
CYDEV_CHIP_REV_LEOPARD_ES3 EQU 3
CYDEV_CHIP_REV_LEOPARD_PRODUCTION EQU 3
CYDEV_CHIP_REV_PANTHER_ES0 EQU 0
CYDEV_CHIP_REV_PANTHER_ES1 EQU 1
CYDEV_CHIP_REV_PANTHER_PRODUCTION EQU 1
CYDEV_CHIP_REV_PSOC4A_ES0 EQU 17
CYDEV_CHIP_REV_PSOC4A_PRODUCTION EQU 17
CYDEV_CHIP_REV_PSOC5LP_ES0 EQU 0
CYDEV_CHIP_REV_PSOC5LP_PRODUCTION EQU 0
CYDEV_CHIP_REV_TMA4_ES EQU 17
CYDEV_CHIP_REV_TMA4_ES2 EQU 33
CYDEV_CHIP_REV_TMA4_PRODUCTION EQU 17
CYDEV_CHIP_REVISION_3A_ES1 EQU 0
CYDEV_CHIP_REVISION_3A_ES2 EQU 1
CYDEV_CHIP_REVISION_3A_ES3 EQU 3
CYDEV_CHIP_REVISION_3A_PRODUCTION EQU 3
CYDEV_CHIP_REVISION_4A_ES0 EQU 17
CYDEV_CHIP_REVISION_4A_PRODUCTION EQU 17
CYDEV_CHIP_REVISION_4C_PRODUCTION EQU 0
CYDEV_CHIP_REVISION_4D_PRODUCTION EQU 0
CYDEV_CHIP_REVISION_4E_PRODUCTION EQU 0
CYDEV_CHIP_REVISION_4F_PRODUCTION EQU 0
CYDEV_CHIP_REVISION_4F_PRODUCTION_256DMA EQU 0
CYDEV_CHIP_REVISION_4F_PRODUCTION_256K EQU 0
CYDEV_CHIP_REVISION_4G_ES EQU 17
CYDEV_CHIP_REVISION_4G_ES2 EQU 33
CYDEV_CHIP_REVISION_4G_PRODUCTION EQU 17
CYDEV_CHIP_REVISION_4H_PRODUCTION EQU 0
CYDEV_CHIP_REVISION_4I_PRODUCTION EQU 0
CYDEV_CHIP_REVISION_4J_PRODUCTION EQU 0
CYDEV_CHIP_REVISION_4K_PRODUCTION EQU 0
CYDEV_CHIP_REVISION_4L_PRODUCTION EQU 0
CYDEV_CHIP_REVISION_4M_PRODUCTION EQU 0
CYDEV_CHIP_REVISION_4N_PRODUCTION EQU 0
CYDEV_CHIP_REVISION_4U_PRODUCTION EQU 0
CYDEV_CHIP_REVISION_5A_ES0 EQU 0
CYDEV_CHIP_REVISION_5A_ES1 EQU 1
CYDEV_CHIP_REVISION_5A_PRODUCTION EQU 1
CYDEV_CHIP_REVISION_5B_ES0 EQU 0
CYDEV_CHIP_REVISION_5B_PRODUCTION EQU 0
CYDEV_CHIP_REVISION_USED EQU CYDEV_CHIP_REVISION_5B_PRODUCTION
CYDEV_CHIP_REV_EXPECT EQU CYDEV_CHIP_REVISION_USED
CYDEV_CONFIG_FASTBOOT_ENABLED EQU 1
CYDEV_CONFIG_UNUSED_IO_AllowButWarn EQU 0
CYDEV_CONFIG_UNUSED_IO EQU CYDEV_CONFIG_UNUSED_IO_AllowButWarn
CYDEV_CONFIG_UNUSED_IO_AllowWithInfo EQU 1
CYDEV_CONFIG_UNUSED_IO_Disallowed EQU 2
CYDEV_CONFIGURATION_COMPRESSED EQU 1
CYDEV_CONFIGURATION_DMA EQU 0
CYDEV_CONFIGURATION_ECC EQU 1
CYDEV_CONFIGURATION_IMOENABLED EQU CYDEV_CONFIG_FASTBOOT_ENABLED
CYDEV_CONFIGURATION_MODE_COMPRESSED EQU 0
CYDEV_CONFIGURATION_MODE EQU CYDEV_CONFIGURATION_MODE_COMPRESSED
CYDEV_CONFIGURATION_MODE_DMA EQU 2
CYDEV_CONFIGURATION_MODE_UNCOMPRESSED EQU 1
CYDEV_DEBUG_ENABLE_MASK EQU 0x20
CYDEV_DEBUG_ENABLE_REGISTER EQU CYREG_MLOGIC_DEBUG
CYDEV_DEBUGGING_DPS_Disable EQU 3
CYDEV_DEBUGGING_DPS_JTAG_4 EQU 1
CYDEV_DEBUGGING_DPS_JTAG_5 EQU 0
CYDEV_DEBUGGING_DPS_SWD EQU 2
CYDEV_DEBUGGING_DPS_SWD_SWV EQU 6
CYDEV_DEBUGGING_DPS EQU CYDEV_DEBUGGING_DPS_SWD_SWV
CYDEV_DEBUGGING_ENABLE EQU 1
CYDEV_DEBUGGING_XRES EQU 0
CYDEV_DMA_CHANNELS_AVAILABLE EQU 24
CYDEV_ECC_ENABLE EQU 0
CYDEV_HEAP_SIZE EQU 0x80
CYDEV_INSTRUCT_CACHE_ENABLED EQU 1
CYDEV_INTR_RISING EQU 0x00000000
CYDEV_IS_EXPORTING_CODE EQU 0
CYDEV_IS_IMPORTING_CODE EQU 0
CYDEV_PROJ_TYPE EQU 0
CYDEV_PROJ_TYPE_BOOTLOADER EQU 1
CYDEV_PROJ_TYPE_LAUNCHER EQU 5
CYDEV_PROJ_TYPE_LOADABLE EQU 2
CYDEV_PROJ_TYPE_LOADABLEANDBOOTLOADER EQU 4
CYDEV_PROJ_TYPE_MULTIAPPBOOTLOADER EQU 3
CYDEV_PROJ_TYPE_STANDARD EQU 0
CYDEV_PROTECTION_ENABLE EQU 0
CYDEV_STACK_SIZE EQU 0x0800
CYDEV_USE_BUNDLED_CMSIS EQU 1
CYDEV_VARIABLE_VDDA EQU 0
CYDEV_VDDA_MV EQU 5000
CYDEV_VDDD_MV EQU 5000
CYDEV_VDDIO0_MV EQU 5000
CYDEV_VDDIO1_MV EQU 5000
CYDEV_VDDIO2_MV EQU 5000
CYDEV_VDDIO3_MV EQU 5000
CYDEV_VIO0_MV EQU 5000
CYDEV_VIO1_MV EQU 5000
CYDEV_VIO2_MV EQU 5000
CYDEV_VIO3_MV EQU 5000
CYIPBLOCK_ARM_CM3_VERSION EQU 0
CYIPBLOCK_P3_ANAIF_VERSION EQU 0
CYIPBLOCK_P3_CAN_VERSION EQU 0
CYIPBLOCK_P3_CAPSENSE_VERSION EQU 0
CYIPBLOCK_P3_COMP_VERSION EQU 0
CYIPBLOCK_P3_DECIMATOR_VERSION EQU 0
CYIPBLOCK_P3_DFB_VERSION EQU 0
CYIPBLOCK_P3_DMA_VERSION EQU 0
CYIPBLOCK_P3_DRQ_VERSION EQU 0
CYIPBLOCK_P3_DSM_VERSION EQU 0
CYIPBLOCK_P3_EMIF_VERSION EQU 0
CYIPBLOCK_P3_I2C_VERSION EQU 0
CYIPBLOCK_P3_LCD_VERSION EQU 0
CYIPBLOCK_P3_LPF_VERSION EQU 0
CYIPBLOCK_P3_OPAMP_VERSION EQU 0
CYIPBLOCK_P3_PM_VERSION EQU 0
CYIPBLOCK_P3_SCCT_VERSION EQU 0
CYIPBLOCK_P3_TIMER_VERSION EQU 0
CYIPBLOCK_P3_USB_VERSION EQU 0
CYIPBLOCK_P3_VIDAC_VERSION EQU 0
CYIPBLOCK_P3_VREF_VERSION EQU 0
CYIPBLOCK_S8_GPIO_VERSION EQU 0
CYIPBLOCK_S8_IRQ_VERSION EQU 0
CYIPBLOCK_S8_SAR_VERSION EQU 0
CYIPBLOCK_S8_SIO_VERSION EQU 0
CYIPBLOCK_S8_UDB_VERSION EQU 0
DMA_CHANNELS_USED__MASK0 EQU 0x00000000
CYDEV_BOOTLOADER_ENABLE EQU 0
    ENDIF
    END
