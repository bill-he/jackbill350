.ifndef INCLUDED_CYFITTERGNU_INC
.set INCLUDED_CYFITTERGNU_INC, 1
.include "cydevicegnu.inc"
.include "cydevicegnu_trm.inc"

/* P00_Vout */
.set P00_Vout__0__INTTYPE, CYREG_PICU0_INTTYPE0
.set P00_Vout__0__MASK, 0x01
.set P00_Vout__0__PC, CYREG_PRT0_PC0
.set P00_Vout__0__PORT, 0
.set P00_Vout__0__SHIFT, 0
.set P00_Vout__AG, CYREG_PRT0_AG
.set P00_Vout__AMUX, CYREG_PRT0_AMUX
.set P00_Vout__BIE, CYREG_PRT0_BIE
.set P00_Vout__BIT_MASK, CYREG_PRT0_BIT_MASK
.set P00_Vout__BYP, CYREG_PRT0_BYP
.set P00_Vout__CTL, CYREG_PRT0_CTL
.set P00_Vout__DM0, CYREG_PRT0_DM0
.set P00_Vout__DM1, CYREG_PRT0_DM1
.set P00_Vout__DM2, CYREG_PRT0_DM2
.set P00_Vout__DR, CYREG_PRT0_DR
.set P00_Vout__INP_DIS, CYREG_PRT0_INP_DIS
.set P00_Vout__INTTYPE_BASE, CYDEV_PICU_INTTYPE_PICU0_BASE
.set P00_Vout__LCD_COM_SEG, CYREG_PRT0_LCD_COM_SEG
.set P00_Vout__LCD_EN, CYREG_PRT0_LCD_EN
.set P00_Vout__MASK, 0x01
.set P00_Vout__PORT, 0
.set P00_Vout__PRT, CYREG_PRT0_PRT
.set P00_Vout__PRTDSI__CAPS_SEL, CYREG_PRT0_CAPS_SEL
.set P00_Vout__PRTDSI__DBL_SYNC_IN, CYREG_PRT0_DBL_SYNC_IN
.set P00_Vout__PRTDSI__OE_SEL0, CYREG_PRT0_OE_SEL0
.set P00_Vout__PRTDSI__OE_SEL1, CYREG_PRT0_OE_SEL1
.set P00_Vout__PRTDSI__OUT_SEL0, CYREG_PRT0_OUT_SEL0
.set P00_Vout__PRTDSI__OUT_SEL1, CYREG_PRT0_OUT_SEL1
.set P00_Vout__PRTDSI__SYNC_OUT, CYREG_PRT0_SYNC_OUT
.set P00_Vout__PS, CYREG_PRT0_PS
.set P00_Vout__SHIFT, 0
.set P00_Vout__SLW, CYREG_PRT0_SLW

/* WaveDAC8_1_BuffAmp_ABuf */
.set WaveDAC8_1_BuffAmp_ABuf__CR, CYREG_OPAMP2_CR
.set WaveDAC8_1_BuffAmp_ABuf__MX, CYREG_OPAMP2_MX
.set WaveDAC8_1_BuffAmp_ABuf__NPUMP_OPAMP_TR0, CYREG_NPUMP_OPAMP_TR0
.set WaveDAC8_1_BuffAmp_ABuf__PM_ACT_CFG, CYREG_PM_ACT_CFG4
.set WaveDAC8_1_BuffAmp_ABuf__PM_ACT_MSK, 0x04
.set WaveDAC8_1_BuffAmp_ABuf__PM_STBY_CFG, CYREG_PM_STBY_CFG4
.set WaveDAC8_1_BuffAmp_ABuf__PM_STBY_MSK, 0x04
.set WaveDAC8_1_BuffAmp_ABuf__RSVD, CYREG_OPAMP2_RSVD
.set WaveDAC8_1_BuffAmp_ABuf__SW, CYREG_OPAMP2_SW
.set WaveDAC8_1_BuffAmp_ABuf__TR0, CYREG_OPAMP2_TR0
.set WaveDAC8_1_BuffAmp_ABuf__TR1, CYREG_OPAMP2_TR1

/* WaveDAC8_1_DacClk */
.set WaveDAC8_1_DacClk__CFG0, CYREG_CLKDIST_DCFG0_CFG0
.set WaveDAC8_1_DacClk__CFG1, CYREG_CLKDIST_DCFG0_CFG1
.set WaveDAC8_1_DacClk__CFG2, CYREG_CLKDIST_DCFG0_CFG2
.set WaveDAC8_1_DacClk__CFG2_SRC_SEL_MASK, 0x07
.set WaveDAC8_1_DacClk__INDEX, 0x00
.set WaveDAC8_1_DacClk__PM_ACT_CFG, CYREG_PM_ACT_CFG2
.set WaveDAC8_1_DacClk__PM_ACT_MSK, 0x01
.set WaveDAC8_1_DacClk__PM_STBY_CFG, CYREG_PM_STBY_CFG2
.set WaveDAC8_1_DacClk__PM_STBY_MSK, 0x01

/* WaveDAC8_1_VDAC8_viDAC8 */
.set WaveDAC8_1_VDAC8_viDAC8__CR0, CYREG_DAC2_CR0
.set WaveDAC8_1_VDAC8_viDAC8__CR1, CYREG_DAC2_CR1
.set WaveDAC8_1_VDAC8_viDAC8__D, CYREG_DAC2_D
.set WaveDAC8_1_VDAC8_viDAC8__PM_ACT_CFG, CYREG_PM_ACT_CFG8
.set WaveDAC8_1_VDAC8_viDAC8__PM_ACT_MSK, 0x04
.set WaveDAC8_1_VDAC8_viDAC8__PM_STBY_CFG, CYREG_PM_STBY_CFG8
.set WaveDAC8_1_VDAC8_viDAC8__PM_STBY_MSK, 0x04
.set WaveDAC8_1_VDAC8_viDAC8__STROBE, CYREG_DAC2_STROBE
.set WaveDAC8_1_VDAC8_viDAC8__SW0, CYREG_DAC2_SW0
.set WaveDAC8_1_VDAC8_viDAC8__SW2, CYREG_DAC2_SW2
.set WaveDAC8_1_VDAC8_viDAC8__SW3, CYREG_DAC2_SW3
.set WaveDAC8_1_VDAC8_viDAC8__SW4, CYREG_DAC2_SW4
.set WaveDAC8_1_VDAC8_viDAC8__TR, CYREG_DAC2_TR
.set WaveDAC8_1_VDAC8_viDAC8__TRIM__M1, CYREG_FLSHID_CUST_TABLES_DAC2_M1
.set WaveDAC8_1_VDAC8_viDAC8__TRIM__M2, CYREG_FLSHID_CUST_TABLES_DAC2_M2
.set WaveDAC8_1_VDAC8_viDAC8__TRIM__M3, CYREG_FLSHID_CUST_TABLES_DAC2_M3
.set WaveDAC8_1_VDAC8_viDAC8__TRIM__M4, CYREG_FLSHID_CUST_TABLES_DAC2_M4
.set WaveDAC8_1_VDAC8_viDAC8__TRIM__M5, CYREG_FLSHID_CUST_TABLES_DAC2_M5
.set WaveDAC8_1_VDAC8_viDAC8__TRIM__M6, CYREG_FLSHID_CUST_TABLES_DAC2_M6
.set WaveDAC8_1_VDAC8_viDAC8__TRIM__M7, CYREG_FLSHID_CUST_TABLES_DAC2_M7
.set WaveDAC8_1_VDAC8_viDAC8__TRIM__M8, CYREG_FLSHID_CUST_TABLES_DAC2_M8
.set WaveDAC8_1_VDAC8_viDAC8__TST, CYREG_DAC2_TST

/* WaveDAC8_1_Wave1_DMA */
.set WaveDAC8_1_Wave1_DMA__DRQ_CTL, CYREG_IDMUX_DRQ_CTL0
.set WaveDAC8_1_Wave1_DMA__DRQ_NUMBER, 0
.set WaveDAC8_1_Wave1_DMA__NUMBEROF_TDS, 0
.set WaveDAC8_1_Wave1_DMA__PRIORITY, 2
.set WaveDAC8_1_Wave1_DMA__TERMIN_EN, 0
.set WaveDAC8_1_Wave1_DMA__TERMIN_SEL, 0
.set WaveDAC8_1_Wave1_DMA__TERMOUT0_EN, 0
.set WaveDAC8_1_Wave1_DMA__TERMOUT0_SEL, 0
.set WaveDAC8_1_Wave1_DMA__TERMOUT1_EN, 0
.set WaveDAC8_1_Wave1_DMA__TERMOUT1_SEL, 0

/* WaveDAC8_1_Wave2_DMA */
.set WaveDAC8_1_Wave2_DMA__DRQ_CTL, CYREG_IDMUX_DRQ_CTL0
.set WaveDAC8_1_Wave2_DMA__DRQ_NUMBER, 1
.set WaveDAC8_1_Wave2_DMA__NUMBEROF_TDS, 0
.set WaveDAC8_1_Wave2_DMA__PRIORITY, 2
.set WaveDAC8_1_Wave2_DMA__TERMIN_EN, 0
.set WaveDAC8_1_Wave2_DMA__TERMIN_SEL, 0
.set WaveDAC8_1_Wave2_DMA__TERMOUT0_EN, 0
.set WaveDAC8_1_Wave2_DMA__TERMOUT0_SEL, 0
.set WaveDAC8_1_Wave2_DMA__TERMOUT1_EN, 0
.set WaveDAC8_1_Wave2_DMA__TERMOUT1_SEL, 0

/* Miscellaneous */
.set BCLK__BUS_CLK__HZ, 24000000
.set BCLK__BUS_CLK__KHZ, 24000
.set BCLK__BUS_CLK__MHZ, 24
.set CYDEV_CHIP_DIE_LEOPARD, 1
.set CYDEV_CHIP_DIE_PANTHER, 18
.set CYDEV_CHIP_DIE_PSOC4A, 10
.set CYDEV_CHIP_DIE_PSOC5LP, 17
.set CYDEV_CHIP_DIE_TMA4, 2
.set CYDEV_CHIP_DIE_UNKNOWN, 0
.set CYDEV_CHIP_FAMILY_PSOC3, 1
.set CYDEV_CHIP_FAMILY_PSOC4, 2
.set CYDEV_CHIP_FAMILY_PSOC5, 3
.set CYDEV_CHIP_FAMILY_UNKNOWN, 0
.set CYDEV_CHIP_FAMILY_USED, CYDEV_CHIP_FAMILY_PSOC5
.set CYDEV_CHIP_JTAG_ID, 0x2E123069
.set CYDEV_CHIP_MEMBER_3A, 1
.set CYDEV_CHIP_MEMBER_4A, 10
.set CYDEV_CHIP_MEMBER_4C, 15
.set CYDEV_CHIP_MEMBER_4D, 6
.set CYDEV_CHIP_MEMBER_4E, 4
.set CYDEV_CHIP_MEMBER_4F, 11
.set CYDEV_CHIP_MEMBER_4G, 2
.set CYDEV_CHIP_MEMBER_4H, 9
.set CYDEV_CHIP_MEMBER_4I, 14
.set CYDEV_CHIP_MEMBER_4J, 7
.set CYDEV_CHIP_MEMBER_4K, 8
.set CYDEV_CHIP_MEMBER_4L, 13
.set CYDEV_CHIP_MEMBER_4M, 12
.set CYDEV_CHIP_MEMBER_4N, 5
.set CYDEV_CHIP_MEMBER_4U, 3
.set CYDEV_CHIP_MEMBER_5A, 17
.set CYDEV_CHIP_MEMBER_5B, 16
.set CYDEV_CHIP_MEMBER_UNKNOWN, 0
.set CYDEV_CHIP_MEMBER_USED, CYDEV_CHIP_MEMBER_5B
.set CYDEV_CHIP_DIE_EXPECT, CYDEV_CHIP_MEMBER_USED
.set CYDEV_CHIP_DIE_ACTUAL, CYDEV_CHIP_DIE_EXPECT
.set CYDEV_CHIP_REV_LEOPARD_ES1, 0
.set CYDEV_CHIP_REV_LEOPARD_ES2, 1
.set CYDEV_CHIP_REV_LEOPARD_ES3, 3
.set CYDEV_CHIP_REV_LEOPARD_PRODUCTION, 3
.set CYDEV_CHIP_REV_PANTHER_ES0, 0
.set CYDEV_CHIP_REV_PANTHER_ES1, 1
.set CYDEV_CHIP_REV_PANTHER_PRODUCTION, 1
.set CYDEV_CHIP_REV_PSOC4A_ES0, 17
.set CYDEV_CHIP_REV_PSOC4A_PRODUCTION, 17
.set CYDEV_CHIP_REV_PSOC5LP_ES0, 0
.set CYDEV_CHIP_REV_PSOC5LP_PRODUCTION, 0
.set CYDEV_CHIP_REV_TMA4_ES, 17
.set CYDEV_CHIP_REV_TMA4_ES2, 33
.set CYDEV_CHIP_REV_TMA4_PRODUCTION, 17
.set CYDEV_CHIP_REVISION_3A_ES1, 0
.set CYDEV_CHIP_REVISION_3A_ES2, 1
.set CYDEV_CHIP_REVISION_3A_ES3, 3
.set CYDEV_CHIP_REVISION_3A_PRODUCTION, 3
.set CYDEV_CHIP_REVISION_4A_ES0, 17
.set CYDEV_CHIP_REVISION_4A_PRODUCTION, 17
.set CYDEV_CHIP_REVISION_4C_PRODUCTION, 0
.set CYDEV_CHIP_REVISION_4D_PRODUCTION, 0
.set CYDEV_CHIP_REVISION_4E_PRODUCTION, 0
.set CYDEV_CHIP_REVISION_4F_PRODUCTION, 0
.set CYDEV_CHIP_REVISION_4F_PRODUCTION_256DMA, 0
.set CYDEV_CHIP_REVISION_4F_PRODUCTION_256K, 0
.set CYDEV_CHIP_REVISION_4G_ES, 17
.set CYDEV_CHIP_REVISION_4G_ES2, 33
.set CYDEV_CHIP_REVISION_4G_PRODUCTION, 17
.set CYDEV_CHIP_REVISION_4H_PRODUCTION, 0
.set CYDEV_CHIP_REVISION_4I_PRODUCTION, 0
.set CYDEV_CHIP_REVISION_4J_PRODUCTION, 0
.set CYDEV_CHIP_REVISION_4K_PRODUCTION, 0
.set CYDEV_CHIP_REVISION_4L_PRODUCTION, 0
.set CYDEV_CHIP_REVISION_4M_PRODUCTION, 0
.set CYDEV_CHIP_REVISION_4N_PRODUCTION, 0
.set CYDEV_CHIP_REVISION_4U_PRODUCTION, 0
.set CYDEV_CHIP_REVISION_5A_ES0, 0
.set CYDEV_CHIP_REVISION_5A_ES1, 1
.set CYDEV_CHIP_REVISION_5A_PRODUCTION, 1
.set CYDEV_CHIP_REVISION_5B_ES0, 0
.set CYDEV_CHIP_REVISION_5B_PRODUCTION, 0
.set CYDEV_CHIP_REVISION_USED, CYDEV_CHIP_REVISION_5B_PRODUCTION
.set CYDEV_CHIP_REV_EXPECT, CYDEV_CHIP_REVISION_USED
.set CYDEV_CONFIG_FASTBOOT_ENABLED, 1
.set CYDEV_CONFIG_UNUSED_IO_AllowButWarn, 0
.set CYDEV_CONFIG_UNUSED_IO, CYDEV_CONFIG_UNUSED_IO_AllowButWarn
.set CYDEV_CONFIG_UNUSED_IO_AllowWithInfo, 1
.set CYDEV_CONFIG_UNUSED_IO_Disallowed, 2
.set CYDEV_CONFIGURATION_COMPRESSED, 1
.set CYDEV_CONFIGURATION_DMA, 0
.set CYDEV_CONFIGURATION_ECC, 1
.set CYDEV_CONFIGURATION_IMOENABLED, CYDEV_CONFIG_FASTBOOT_ENABLED
.set CYDEV_CONFIGURATION_MODE_COMPRESSED, 0
.set CYDEV_CONFIGURATION_MODE, CYDEV_CONFIGURATION_MODE_COMPRESSED
.set CYDEV_CONFIGURATION_MODE_DMA, 2
.set CYDEV_CONFIGURATION_MODE_UNCOMPRESSED, 1
.set CYDEV_DEBUG_ENABLE_MASK, 0x20
.set CYDEV_DEBUG_ENABLE_REGISTER, CYREG_MLOGIC_DEBUG
.set CYDEV_DEBUGGING_DPS_Disable, 3
.set CYDEV_DEBUGGING_DPS_JTAG_4, 1
.set CYDEV_DEBUGGING_DPS_JTAG_5, 0
.set CYDEV_DEBUGGING_DPS_SWD, 2
.set CYDEV_DEBUGGING_DPS_SWD_SWV, 6
.set CYDEV_DEBUGGING_DPS, CYDEV_DEBUGGING_DPS_SWD_SWV
.set CYDEV_DEBUGGING_ENABLE, 1
.set CYDEV_DEBUGGING_XRES, 0
.set CYDEV_DMA_CHANNELS_AVAILABLE, 24
.set CYDEV_ECC_ENABLE, 0
.set CYDEV_HEAP_SIZE, 0x1000
.set CYDEV_INSTRUCT_CACHE_ENABLED, 1
.set CYDEV_INTR_RISING, 0x00000000
.set CYDEV_IS_EXPORTING_CODE, 0
.set CYDEV_IS_IMPORTING_CODE, 0
.set CYDEV_PROJ_TYPE, 0
.set CYDEV_PROJ_TYPE_BOOTLOADER, 1
.set CYDEV_PROJ_TYPE_LAUNCHER, 5
.set CYDEV_PROJ_TYPE_LOADABLE, 2
.set CYDEV_PROJ_TYPE_LOADABLEANDBOOTLOADER, 4
.set CYDEV_PROJ_TYPE_MULTIAPPBOOTLOADER, 3
.set CYDEV_PROJ_TYPE_STANDARD, 0
.set CYDEV_PROTECTION_ENABLE, 0
.set CYDEV_STACK_SIZE, 0x4000
.set CYDEV_USE_BUNDLED_CMSIS, 1
.set CYDEV_VARIABLE_VDDA, 0
.set CYDEV_VDDA_MV, 5000
.set CYDEV_VDDD_MV, 5000
.set CYDEV_VDDIO0_MV, 5000
.set CYDEV_VDDIO1_MV, 5000
.set CYDEV_VDDIO2_MV, 5000
.set CYDEV_VDDIO3_MV, 5000
.set CYDEV_VIO0_MV, 5000
.set CYDEV_VIO1_MV, 5000
.set CYDEV_VIO2_MV, 5000
.set CYDEV_VIO3_MV, 5000
.set CYIPBLOCK_ARM_CM3_VERSION, 0
.set CYIPBLOCK_P3_ANAIF_VERSION, 0
.set CYIPBLOCK_P3_CAN_VERSION, 0
.set CYIPBLOCK_P3_CAPSENSE_VERSION, 0
.set CYIPBLOCK_P3_COMP_VERSION, 0
.set CYIPBLOCK_P3_DECIMATOR_VERSION, 0
.set CYIPBLOCK_P3_DFB_VERSION, 0
.set CYIPBLOCK_P3_DMA_VERSION, 0
.set CYIPBLOCK_P3_DRQ_VERSION, 0
.set CYIPBLOCK_P3_DSM_VERSION, 0
.set CYIPBLOCK_P3_EMIF_VERSION, 0
.set CYIPBLOCK_P3_I2C_VERSION, 0
.set CYIPBLOCK_P3_LCD_VERSION, 0
.set CYIPBLOCK_P3_LPF_VERSION, 0
.set CYIPBLOCK_P3_OPAMP_VERSION, 0
.set CYIPBLOCK_P3_PM_VERSION, 0
.set CYIPBLOCK_P3_SCCT_VERSION, 0
.set CYIPBLOCK_P3_TIMER_VERSION, 0
.set CYIPBLOCK_P3_USB_VERSION, 0
.set CYIPBLOCK_P3_VIDAC_VERSION, 0
.set CYIPBLOCK_P3_VREF_VERSION, 0
.set CYIPBLOCK_S8_GPIO_VERSION, 0
.set CYIPBLOCK_S8_IRQ_VERSION, 0
.set CYIPBLOCK_S8_SAR_VERSION, 0
.set CYIPBLOCK_S8_SIO_VERSION, 0
.set CYIPBLOCK_S8_UDB_VERSION, 0
.set DMA_CHANNELS_USED__MASK0, 0x00000003
.set CYDEV_BOOTLOADER_ENABLE, 0
.endif
